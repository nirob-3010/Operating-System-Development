## Config.in
```kconfig
menu "NSK OS packages"
source "$BR2_EXTERNAL_NSKOS_PATH/package/nskdesktop/Config.in"
endmenu
```

## package/nskdesktop/Config.in
```kconfig
config BR2_PACKAGE_NSKDESKTOP
    bool "nskdesktop"
    help
      Minimal framebuffer desktop shell for NSK OS.
```
